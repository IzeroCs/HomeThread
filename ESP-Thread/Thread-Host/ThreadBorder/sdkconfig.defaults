## ESP-Thread/Thread-Host/ThreadBorder/sdkconfig.defaults
```kconfig
#
# Partition Table
#
CONFIG_PARTITION_TABLE_CUSTOM=y
CONFIG_PARTITION_TABLE_CUSTOM_FILENAME="partitions.csv"
CONFIG_PARTITION_TABLE_FILENAME="partitions.csv"
CONFIG_PARTITION_TABLE_OFFSET=0x8000
CONFIG_PARTITION_TABLE_MD5=y
# end of Partition Table

#
# mbedTLS
#
CONFIG_MBEDTLS_CMAC_C=y
CONFIG_MBEDTLS_SSL_PROTO_DTLS=y
CONFIG_MBEDTLS_KEY_EXCHANGE_ECJPAKE=y
CONFIG_MBEDTLS_ECJPAKE_C=y
# end of mbedTLS

#
# OpenThread
#
CONFIG_OPENTHREAD_ENABLED=y
CONFIG_OPENTHREAD_FTD=y
CONFIG_OPENTHREAD_BORDER_ROUTER=n
CONFIG_OPENTHREAD_RADIO_NATIVE=y
CONFIG_OPENTHREAD_TASK_SIZE=10240
CONFIG_OPENTHREAD_CONSOLE_ENABLE=n
# CONFIG_OPENTHREAD_CLI is not set
# CONFIG_OPENTHREAD_CLI_ESP_EXTENSION is not set
CONFIG_OPENTHREAD_COMMISSIONER=y
CONFIG_OPENTHREAD_HEADER_CUSTOM=y
CONFIG_OPENTHREAD_CUSTOM_HEADER_PATH="main"
CONFIG_OPENTHREAD_HEADER_CUSTOM_FILENAME="openthread_custom_config.h"
CONFIG_OPENTHREAD_CUSTOM_HEADER_FILE_NAME="openthread_custom_config.h"
# end of OpenThread

#
# lwIP
#
CONFIG_LWIP_TCPIP_TASK_STACK_SIZE=4096
CONFIG_LWIP_IPV6_NUM_ADDRESSES=8
CONFIG_LWIP_MULTICAST_PING=y
CONFIG_LWIP_HOOK_IP6_SELECT_SRC_ADDR_CUSTOM=y
# end of lwIP

#
# ESP System Settings
#
CONFIG_ESP_MAIN_TASK_STACK_SIZE=6144
# end of ESP System Settings

#
# Console UART (tránh baud bị đổi / tràn log)
#
CONFIG_ESP_CONSOLE_UART_DEFAULT=y
CONFIG_ESP_CONSOLE_UART_BAUDRATE=115200
CONFIG_ESPTOOLPY_MONITOR_BAUD=115200

#
# Giảm log OpenThread (tránh tràn UART khi chuyển leader)
#
CONFIG_OPENTHREAD_LOG_LEVEL_DYNAMIC=n
CONFIG_OPENTHREAD_LOG_LEVEL_NONE=y
```

## ESP-Thread/Thread-Host/main/Kconfig.projbuild
```kconfig
menu "ESP Thread Border Router"

config LED_STATUS_ENABLE
    bool "Bật LED trạng thái RGB WS2812 (disabled=đỏ nhấp nháy, detached=xanh dương nhấp nháy, leader=xanh lá tĩnh, router=tím tĩnh, child=xanh dương tĩnh)"
    default y
    help
        LED WS2812/WS2812B addressable RGB LED trên ESP32-S3.
        ESP32-S3 DevKitC-1: GPIO 48 (onboard LED) hoặc GPIO 5 (external LED).

config LED_STATUS_GPIO
    int "GPIO cho LED RGB data (WS2812)"
    depends on LED_STATUS_ENABLE
    default 48
    range 0 48
    help
        GPIO pin cho data line của WS2812/WS2812B LED.
        ESP32-S3 DevKitC-1: GPIO 48 cho onboard LED, GPIO 5 cho external LED.

config BR_ETH_W5500_ENABLE
    bool "Bật Ethernet W5500 (backhaul ưu tiên, SPI)"
    default y
    select ETH_USE_SPI_ETHERNET
    select ETH_SPI_ETHERNET_W5500
    help
        BR dùng W5500 qua SPI làm backhaul (chỉ LAN, không Wi-Fi). ESP32-S3 không có EMAC.

if BR_ETH_W5500_ENABLE
    config BR_ETH_SPI_HOST
        int "SPI host cho W5500"
        range 0 2
        default 2
        help
            SPI2 thường dùng để tránh conflict UART RCP (SPI1 có thể dùng cho flash).

    config BR_ETH_SPI_SCLK_GPIO
        int "W5500 SCLK GPIO"
        default 12
        help
            ESP32-S3: 12 gợi ý cho SPI2.

    config BR_ETH_SPI_MOSI_GPIO
        int "W5500 MOSI GPIO"
        default 11

    config BR_ETH_SPI_MISO_GPIO
        int "W5500 MISO GPIO"
        default 13

    config BR_ETH_SPI_CS_GPIO
        int "W5500 CS GPIO"
        default 10

    config BR_ETH_SPI_CLOCK_MHZ
        int "SPI clock (MHz)"
        range 5 40
        default 20

    config BR_ETH_INT_GPIO
        int "W5500 INT GPIO (-1 = polling)"
        default -1
        help
            -1 để dùng polling (tránh conflict GPIO).

    config BR_ETH_POLLING_MS
        int "W5500 polling period (ms, khi INT=-1)"
        default 20
        help
            Chu kỳ poll khi không dùng interrupt; bỏ qua khi dùng INT.

    config BR_ETH_LINK_TIMEOUT_MS
        int "Timeout chờ IP trên Ethernet (ms)"
        default 15000
        help
            Chờ có IPv4 (DHCP) hoặc IPv6 (link-local/RA). Cắm trực tiếp BR-backend link có thể lên ~4–5s, IPv6 event sau đó; nên >= 10s.
endif

config BR_FRAME_TCP_PORT
    int "Port TCP cho kênh frame (BR listen)"
    default 5000
    range 1 65535
    help
        BR listen trên port này; dashboard kết nối tới BR_IP:port để gửi/nhận frame.

endmenu
```

## ESP-Thread/Thread-Host/sdkconfig.defaults
```kconfig
# Thread Border Router: ESP32-S3 Host + ESP32-H2 RCP, UART only. Không WiFi/Ethernet.
# RCP: UART 460800, GPIO4 (RX), GPIO5 (TX).

CONFIG_IDF_TARGET="esp32s3"

#
# Serial flasher
#
CONFIG_ESPTOOLPY_FLASHSIZE_8MB=y

#
# Partition Table
#
CONFIG_PARTITION_TABLE_CUSTOM=y
CONFIG_PARTITION_TABLE_CUSTOM_FILENAME="partitions.csv"
CONFIG_PARTITION_TABLE_FILENAME="partitions.csv"
CONFIG_PARTITION_TABLE_OFFSET=0x8000
CONFIG_PARTITION_TABLE_MD5=y
CONFIG_OPENTHREAD_CUSTOM_HEADER_PATH="main"
CONFIG_OPENTHREAD_HEADER_CUSTOM_FILENAME="br_custom_config.h"
CONFIG_OPENTHREAD_CUSTOM_HEADER_FILE_NAME="br_custom_config.h"

#
# Compiler
#
CONFIG_COMPILER_OPTIMIZATION_SIZE=y
CONFIG_NEWLIB_NANO_FORMAT=y

#
# mbedTLS (Thread/DTLS)
#
CONFIG_MBEDTLS_CMAC_C=y
CONFIG_MBEDTLS_SSL_PROTO_DTLS=y
CONFIG_MBEDTLS_KEY_EXCHANGE_ECJPAKE=y
CONFIG_MBEDTLS_ECJPAKE_C=y

#
# OpenThread
#
CONFIG_OPENTHREAD_ENABLED=y
CONFIG_OPENTHREAD_BORDER_ROUTER=y
CONFIG_OPENTHREAD_BORDER_AGENT_ENABLE=y
CONFIG_OPENTHREAD_COMMISSIONER=y
CONFIG_OPENTHREAD_CLI_OTA=n
CONFIG_OPENTHREAD_RCP_COMMAND=y
CONFIG_OPENTHREAD_RADIO_SPINEL_UART=y
CONFIG_OPENTHREAD_RADIO_TREL=n
CONFIG_OPENTHREAD_TASK_SIZE=8192

#
# OpenThread Border Router Example
#
CONFIG_ESP_BR_H2_TARGET=y

#
# lwIP
#
CONFIG_LWIP_IPV6_FORWARD=y
CONFIG_LWIP_IPV6_NUM_ADDRESSES=12
CONFIG_LWIP_MULTICAST_PING=y
CONFIG_LWIP_NETIF_STATUS_CALLBACK=y
CONFIG_LWIP_HOOK_IP6_ROUTE_DEFAULT=y
CONFIG_LWIP_HOOK_ND6_GET_GW_DEFAULT=y
CONFIG_LWIP_HOOK_IP6_INPUT_CUSTOM=y
CONFIG_LWIP_IPV6_AUTOCONFIG=y
CONFIG_LWIP_HOOK_IP6_SELECT_SRC_ADDR_CUSTOM=y
CONFIG_LWIP_FORCE_ROUTER_FORWARDING=y

#
# ESP System
#
CONFIG_ESP_SYSTEM_EVENT_TASK_STACK_SIZE=3584
CONFIG_ESP_MAIN_TASK_STACK_SIZE=5120

#
# Border Router board / console
#
CONFIG_ESP_BR_BOARD_DEV_KIT=y
CONFIG_ESP_CONSOLE_UART_DEFAULT=y
CONFIG_ESP_CONSOLE_UART_NUM=0
# CONFIG_ESP_CONSOLE_USB_CDC is not set
# CONFIG_ESP_CONSOLE_USB_SERIAL_JTAG is not set
CONFIG_ESP_CONSOLE_SECONDARY_NONE=y
# CONFIG_ESP_CONSOLE_SECONDARY_USB_SERIAL_JTAG is not set
# USB CDC dùng cho frame only; log/console chỉ ra UART (không output ra USB)

#
# UART Host–RCP (ESP32-S3: GPIO4=RX, GPIO5=TX recommended)
#
CONFIG_PIN_TO_RCP_TX=4
CONFIG_PIN_TO_RCP_RX=5

#
# RCP update pins (adjust to your wiring)
#
CONFIG_PIN_TO_RCP_RESET=7
CONFIG_PIN_TO_RCP_BOOT=8

#
# HTTP server
#
CONFIG_HTTPD_MAX_REQ_HDR_LEN=1024
```

## ESP-Thread/Thread-Node/components/thread/boot_btn/Kconfig
```kconfig
menu "Boot Button"

config BOOT_BTN_GPIO_DEFAULT
    int "GPIO so cua nut BOOT (mac dinh theo target)"
    default 9 if IDF_TARGET_ESP32C6
    default 9 if IDF_TARGET_ESP32H2
    default 9
    help
        Tu dong theo board: ESP32-C6-DevKitC-1 va ESP32-H2-DevKitM-1 deu dung GPIO 9.
        Co the doi trong menuconfig neu board khac.

config BOOT_BTN_HOLD_MS_DEFAULT
    int "Thoi gian giu (ms) de kich hoat long press"
    default 5000
    range 1000 30000
    help
        Giu nut trong khoang nay de goi on_long_press.

config BOOT_BTN_POLL_MS_DEFAULT
    int "Chu ky poll (ms)"
    default 200
    range 50 500
    help
        Tan so kiem tra trang thai nut.

endmenu
```

## ESP-Thread/ThreadBorder/main/Kconfig.projbuild
```kconfig
menu "OpenThread FTD Example"

config LED_STATUS_ENABLE
    bool "Bật LED trạng thái RGB WS2812 (boot=đỏ nhấp nháy, detached=xanh dương nhấp nháy, leader=xanh lá tĩnh)"
    default y
    help
        LED WS2812/addressable 1 chân data trên ESP32-H2 (mặc định GPIO 8).

config LED_STATUS_GPIO
    int "GPIO cho LED RGB data (WS2812)"
    depends on LED_STATUS_ENABLE
    default 8
    range 0 27

endmenu
```

## ESP-Thread/ThreadEndPoint/components/entity/model/Kconfig
```kconfig
menu "Entity Model"

config ENTITY_MODEL_MAX_TYPES
    int "Max entity types (type registry)"
    default 4
    range 1 16
    help
        Maximum number of entity types that can be registered
        (e.g. on_off_light, temperature_sensor).

config ENTITY_MODEL_MAX_ENTITIES
    int "Max entities"
    default 8
    range 1 32
    help
        Maximum number of entities (e.g. light.0, sensor.0).

endmenu
```

## ESP-Thread/ThreadEndPoint/components/status_led/Kconfig
```kconfig
menu "Status LED (RGB WS2812)"

config STATUS_LED_GPIO_DEFAULT
    int "GPIO cua RGB LED (WS2812, 1 data line)"
    default 8 if IDF_TARGET_ESP32C6
    default 8 if IDF_TARGET_ESP32H2
    default 8
    help
        ESP32-C6-DevKitC-1 va ESP32-H2-DevKitM-1 deu dung GPIO 8 cho RGB LED.

config STATUS_LED_BLINK_MS
    int "Chu ky nhap nhay (ms)"
    default 500
    range 200 2000
    help
        Thoi gian on/off cho cac trang thai nhap nhay (do, vang, xanh duong).

endmenu
```

## ESP-Thread/ThreadEndPoint/components/thread_joiner/Kconfig
```kconfig
menu "Thread Joiner"

config THREAD_JOINER_PSKD_DEFAULT
    string "Default PSKd (Joiner credential)"
    default "H01THREAD"
    help
        Default PSKd for Thread commissioning (6-32 chars, base32-thread).
        Must match "commissioner joiner add * <pskd>" on Border Router.

config THREAD_JOINER_RETRY_SEC
    int "Joiner retry interval (seconds) - loi chung"
    default 30
    range 10 300
    help
        Khi Joiner that bai (loi khac NotFound), tu dong thu lai sau N giay.

config THREAD_JOINER_RETRY_NOT_FOUND_SEC
    int "Joiner retry interval (seconds) khi loi NotFound - Commissioner chua bat"
    default 5
    range 2 60
    help
        Khi Joiner tra ve NotFound (Commissioner chua san sang), thu lai sau N giay thay vi RETRY_SEC.

endmenu
```
